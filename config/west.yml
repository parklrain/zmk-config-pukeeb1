## config/west.yml
```yaml
manifest:
  remotes:
    - name: zephyrproject-rtos
      url-base: https://github.com/zephyrproject-rtos
    - name: zmkfirmware
      url-base: https://github.com/zmkfirmware
    - name: badjeff
      url-base: https://github.com/badjeff
    - name: infused-kim
      url-base: https://github.com/infused-kim
    - name: klesh
      url-base: https://github.com/klesh
  projects:
    - name: zmk
      remote: klesh
      revision: main
      import: app/west.yml
    - name: kb_zmk_ps2_mouse_trackpoint_driver
      remote: klesh
      revision: main
  self:
    path: config
```
